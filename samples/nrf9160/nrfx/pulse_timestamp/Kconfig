## samples/nrf9160/nrfx/pulse_timestamp/Kconfig
```kconfig
#
# Copyright (c) 2020 Nordic Semiconductor ASA
#
# SPDX-License-Identifier: LicenseRef-Nordic-5-Clause
#

menu "modem off Sample Settings"

#nothing here yet.
endmenu


menu "Zephyr Kernel"
source "Kconfig.zephyr"
endmenu
```
